## buildroot-rockore/Config.in
```kconfig
menu "Custom Packages"
source "$BR2_EXTERNAL_ROCKORE_BR_PATH/package/Config.in"
endmenu
```

## buildroot-rockore/package/Config.in
```kconfig
source "$BR2_EXTERNAL_ROCKORE_BR_PATH/package/buildah/Config.in"
source "$BR2_EXTERNAL_ROCKORE_BR_PATH/package/conmon/Config.in"
source "$BR2_EXTERNAL_ROCKORE_BR_PATH/package/cri-tools/Config.in"
source "$BR2_EXTERNAL_ROCKORE_BR_PATH/package/crio/Config.in"
source "$BR2_EXTERNAL_ROCKORE_BR_PATH/package/openvswitch/Config.in"
source "$BR2_EXTERNAL_ROCKORE_BR_PATH/package/podman/Config.in"
source "$BR2_EXTERNAL_ROCKORE_BR_PATH/package/shadow/Config.in"
```

## buildroot-rockore/package/buildah/Config.in
```kconfig
config BR2_PACKAGE_BUILDAH
	bool "buildah"
	depends on BR2_PACKAGE_CRUN || BR2_PACKAGE_RUNC
	depends on BR2_PACKAGE_HOST_GO_TARGET_ARCH_SUPPORTS
	depends on BR2_PACKAGE_HOST_GO_TARGET_CGO_LINKING_SUPPORTS
	depends on BR2_TOOLCHAIN_HAS_THREADS
	depends on !BR2_TOOLCHAIN_USES_UCLIBC
	depends on BR2_USE_MMU
	select BR2_PACKAGE_BTRFS_PROGS
	select BR2_PACKAGE_LIBGLIB2
	select BR2_PACKAGE_LIBGPGME
	select BR2_PACKAGE_LIBASSUAN
	select BR2_PACKAGE_LIBSECCOMP
	select BR2_PACKAGE_GIT
	select BR2_PACKAGE_BZIP2


	help
	  The Buildah package provides a command line tool that can be used to:
	  - create a working container, either from scratch or using an image as a starting point
	  - create an image, either from a working container or via the instructions in a Dockerfile
	  - images can be built in either the OCI image format or the traditional upstream docker image format
	  - mount a working container's root filesystem for manipulation
	  - unmount a working container's root filesystem
	  - use the updated contents of a container's root filesystem as a filesystem layer to create a new image
	  - delete a working container or an image
	  - rename a local container

	  https://github.com/containers/buildah
```

## buildroot-rockore/package/conmon/Config.in
```kconfig
config BR2_PACKAGE_CONMON
	bool "conmon"
	depends on BR2_PACKAGE_HOST_GO_TARGET_ARCH_SUPPORTS
	depends on BR2_PACKAGE_HOST_GO_TARGET_CGO_LINKING_SUPPORTS
	depends on BR2_TOOLCHAIN_HAS_THREADS
	depends on !BR2_TOOLCHAIN_USES_UCLIBC
	depends on BR2_USE_MMU
	select BR2_PACKAGE_LIBGLIB2

	help
	  An OCI container runtime monitor.
	  Conmon is a monitoring program and communication tool
	  between a container manager (like Podman or CRI-O) and an
	   OCI runtime (like runc or crun) for a single container.

	  https://github.com/containers/conmon
```

## buildroot-rockore/package/openvswitch/Config.in
```kconfig
config BR2_PACKAGE_OPENVSWITCH
	bool "openvswitch"
	depends on BR2_PACKAGE_HOST_GO_TARGET_ARCH_SUPPORTS
	depends on BR2_PACKAGE_HOST_GO_TARGET_CGO_LINKING_SUPPORTS
	depends on BR2_TOOLCHAIN_HAS_THREADS
	depends on !BR2_TOOLCHAIN_USES_UCLIBC
	depends on BR2_USE_MMU
	select BR2_PACKAGE_LIBGLIB2

	help
	  Open vSwitch is a multilayer software switch. Our goal is to 
	  implement a production quality switch platform that supports
	  standard management interfaces and opens the forwarding 
	  functions to programmatic extension and control.

	  https://github.com/openvswitch/ovs
```

## buildroot-rockore/package/shadow/Config.in
```kconfig
config BR2_PACKAGE_SHADOW
	bool "shadow tools"
	depends on BR2_USE_MMU
	select BR2_PACKAGE_LIBXSLT
	select BR2_PACKAGE_LIBSEMANAGE
	help
	  Tools for managing users and groups.
	  This includes tools like:
	    - chage
	    - check_subid_range
	    - chfn
	    - chgpasswd
	    - chpasswd
	    - chsh
	    - expiry
	    - faillog
	    - free_subid_range
	    - get_subid_owners
	    - getsubids
	    - gpasswd
	    - groupadd
	    - groupdel
	    - groupmems
	    - groupmod
	    - groups
	    - grpck
	    - grpconv
	    - grpunconv
	    - id
	    - lastlog
	    - login
	    - logoutd
	    - newgidmap
	    - newgrp
	    - new_subid_range
	    - newuidmap
	    - newusers
	    - nologin
	    - passwd
	    - pwck
	    - pwconv
	    - pwunconv
	    - su
	    - sulogin
	    - useradd
	    - userdel
	    - usermod
	    - vipw

	  https://github.com/shadow-maint/shadow
```

## buildroot-setup/package/containernetworking-plugins/Config.in
```kconfig
config BR2_PACKAGE_CONTAINERNETWORKING_PLUGINS
	bool "containernetworking-plugins"
	depends on BR2_PACKAGE_HOST_GO_TARGET_ARCH_SUPPORTS
	depends on BR2_PACKAGE_HOST_GO_TARGET_CGO_LINKING_SUPPORTS
	depends on BR2_TOOLCHAIN_HAS_THREADS
	depends on BR2_USE_MMU

	help
	  Some CNI network plugins, maintained by the containernetworking team.
	  CNI (Container Network Interface), a Cloud Native Computing Foundation
	  project, consists of a specification and libraries for writing plugins
	  to configure network interfaces in Linux containers, along with a 
	  number of supported plugins.

	  https://github.com/containernetworking/plugins
```

## buildroot-setup/package/cri-tools/Config.in
```kconfig
config BR2_PACKAGE_CRI_TOOLS
	bool "cri-tools"
	depends on BR2_PACKAGE_HOST_GO_TARGET_ARCH_SUPPORTS
	depends on BR2_PACKAGE_HOST_GO_TARGET_CGO_LINKING_SUPPORTS
	depends on BR2_TOOLCHAIN_HAS_THREADS

	help
	  CLI and validation tools for Kubelet Container Runtime Interface (CRI) .

	  https://github.com/kubernetes-sigs/cri-tools
```

## buildroot-setup/package/crio/Config.in
```kconfig
config BR2_PACKAGE_CRIO
	bool "cri-o"
	depends on BR2_PACKAGE_CRUN || BR2_PACKAGE_RUNC
	depends on BR2_PACKAGE_HOST_GO_TARGET_ARCH_SUPPORTS
	depends on BR2_PACKAGE_HOST_GO_TARGET_CGO_LINKING_SUPPORTS
	depends on BR2_TOOLCHAIN_HAS_THREADS
	depends on !BR2_TOOLCHAIN_USES_UCLIBC
	depends on BR2_USE_MMU
	select BR2_PACKAGE_BTRFS_PROGS
	select BR2_PACKAGE_CONMON
	select BR2_PACKAGE_LIBGPGME
	select BR2_PACKAGE_LIBSECCOMP
	select BR2_PACKAGE_IPROUTE2
	select BR2_PACKAGE_IPTABLES
	select BR2_PACKAGE_UTIL_LINUX_NSENTER
	select BR2_PACKAGE_LVM2

	help
	  CRI-O is meant to provide an integration path between OCI conformant 
	  runtimes and the kubelet. Specifically, it implements the Kubelet 
	  Container Runtime Interface (CRI) using OCI conformant runtimes. 
	  The scope of CRI-O is tied to the scope of the CRI.

	  https://github.com/cri-o/cri-o
```

## buildroot-setup/package/crun/Config.in
```kconfig
config BR2_PACKAGE_CRUN
	bool "crun"
	depends on BR2_USE_MMU
	select BR2_PACKAGE_LIBYAJL
	select BR2_PACKAGE_LIBSECCOMP
	select BR2_PACKAGE_LIBCAP
	help
	  A fast and low-memory footprint OCI Container Runtime fully written in C.

	  https://github.com/containers/crun
```

## buildroot-setup/package/libslirp/Config.in
```kconfig
config BR2_PACKAGE_LIBSLIRP
	bool "libslirp"
	depends on BR2_USE_MMU
	select BR2_PACKAGE_LIBGLIB2
	help
	  libslirp is a user-mode networking library used by virtual machines, containers or various tools.

	  https://gitlab.freedesktop.org/slirp/libslirp
```

## buildroot-setup/package/libyajl/Config.in
```kconfig
config BR2_PACKAGE_LIBYAJL
	bool "libyajl"
	depends on BR2_USE_MMU
	help
	  Welcome to Yet Another JSON Library (YAJL)
	
          ## Why does the world need another C library for parsing JSON?  
	
	  Good question.  In a review of current C JSON parsing libraries I was 
	  unable to find one that satisfies my requirements.  Those are, 
	  0. written in C
	  1. portable
	  2. robust -- as close to "crash proof" as possible
	  3. data representation independent
	  4. fast
	  5. generates verbose, useful error messages including context of where
	     the error occurs in the input text.
	  6. can parse JSON data off a stream, incrementally
	  7. simple to use
	  8. tiny
	
	  https://github.com/lloyd/yajl
```

## buildroot-setup/package/podman/Config.in
```kconfig
config BR2_PACKAGE_PODMAN
	bool "podman"
	depends on BR2_PACKAGE_CRUN || BR2_PACKAGE_RUNC
	depends on BR2_PACKAGE_HOST_GO_TARGET_ARCH_SUPPORTS
	depends on BR2_PACKAGE_HOST_GO_TARGET_CGO_LINKING_SUPPORTS
	depends on BR2_TOOLCHAIN_HAS_THREADS
	depends on !BR2_TOOLCHAIN_USES_UCLIBC
	depends on BR2_USE_MMU
	select BR2_PACKAGE_BTRFS_PROGS
	select BR2_PACKAGE_CONMON
	select BR2_PACKAGE_LIBGPGME
	select BR2_PACKAGE_UTIL_LINUX_NSENTER
	select BR2_PACKAGE_LIBSECCOMP

	help
	  Podman (the POD MANager) is a tool for managing containers and images, 
          volumes mounted into those containers, and pods made from groups of 
          containers

	  https://github.com/containers/podman
```

## buildroot-setup/package/slirp4netns/Config.in
```kconfig
config BR2_PACKAGE_SLIRP4NETNS
	bool "slirp4netns"
	depends on BR2_USE_MMU
	select BR2_PACKAGE_LIBGLIB2
	select BR2_PACKAGE_LIBCAP
	select BR2_PACKAGE_LIBSECCOMP
	select BR2_PACKAGE_LIBSLIRP
	help
	  slirp4netns provides user-mode networking ("slirp") for unprivileged network namespaces.

	  https://github.com/rootless-containers/slirp4netns
```
